// SPDX-License-Identifier: GPL-2.0-only

#include "ipq5018.dtsi"

&q6_region {
	reg = <0x0 0x4ab00000 0x0 0x03700000>;
	no-map;
};

&m3_dump_region {
	reg = <0x0 0x4e300000 0x0 0x100000>;
	no-map;
};
